/dts-v1/;

/ {
	compatible = "sprd,v880";
	model = "Unisoc UMS512 1H10 board";
	sprd,sc-id = "ums512 v880 1000";

	__fixups__ {
		adi_bus = "/fragment@20:target:0";
		aon_clk = "/fragment/__overlay__/sprd-marlin3:clocks:0";
		aon_i2c0 = "/fragment@12:target:0";
		aonapb_gate = "/fragment/__overlay__/sprd-marlin3:clocks:12";
		ap_clk = "/fragment@4/__overlay__:clocks:8";
		ap_gpio = "/fragment/__overlay__/fingerprint@0:rst-gpios:0", "/fragment/__overlay__/gpio-keys/key-volumedown:gpios:0", "/fragment/__overlay__/flash-gpio:flash-torch-en-gpios:0", "/fragment/__overlay__/flash-gpio:flash-en-gpios:0", "/fragment/__overlay__/sprd-marlin3:m2-to-ap-coexist-gpios:0", "/fragment/__overlay__/sprd-marlin3:m2-wakeup-ap-gpios:0", "/fragment/__overlay__/sprd-marlin3:permit-ap-send-gpios:0", "/fragment/__overlay__/sprd-marlin3:reset-gpios:0", "/fragment/__overlay__/sprd-marlin3:enable-gpios:0", "/fragment/__overlay__/sprd-marlin3:m2-to-ap-irq-gpios:0", "/fragment@7/__overlay__/sensor-main@20:avdd-gpios:0", "/fragment@7/__overlay__/sensor-main@20:reset-gpios:0", "/fragment@8/__overlay__/sensor-sub@5a:reset-gpios:0", "/fragment@8/__overlay__/sensor-main2@20:reset-gpios:0", "/fragment@8/__overlay__/sensor-main2@20:power-down-gpios:0", "/fragment@11/__overlay__/ocp_wpad@3e:ocp,p-gpio:0", "/fragment@11/__overlay__/ocp_wpad@3e:ocp,n-gpio:0", "/fragment@13/__overlay__/spi_touch@0:touch,reset-gpio:0", "/fragment@13/__overlay__/spi_touch@0:touch,irq-gpio:0", "/fragment@14/__overlay__:reset-gpio:0", "/fragment@24/__overlay__:sprd,spk-ext-pa-gpio:0";
		apapb_gate = "/fragment@4/__overlay__:clocks:0";
		chosen = "/fragment@0:target:0";
		csi0 = "/fragment@7/__overlay__/sensor-main@20:csi:0", "/fragment@8/__overlay__/sensor-sub@5a:csi:0";
		csi1 = "/fragment@8/__overlay__/sensor-main2@20:csi:0";
		ddr_dfs = "/fragment@16:target:0";
		dpu = "/fragment@15:target:0", "/fragment@26:target:0";
		dvfs_dcdc_cpu0_supply = "/fragment@21:target:0";
		dvfs_dcdc_cpu1_supply = "/fragment@22:target:0";
		eic_async = "/fragment/__overlay__/fingerprint@0:irq-gpios:0";
		eic_sync = "/fragment@2/__overlay__:cd-gpios:0";
		ext_26m = "/fragment@7/__overlay__/sensor-main@20:clocks:40", "/fragment@8/__overlay__/sensor-sub@5a:clocks:40", "/fragment@8/__overlay__/sensor-main2@20:clocks:40";
		ext_32k = "/fragment/__overlay__/sprd-marlin3:clocks:8";
		extcon_gpio = "/fragment@12/__overlay__/charger@6b:extcon:0", "/fragment@18/__overlay__:extcon:0";
		hsphy = "/fragment@12/__overlay__/charger@6b:phys:0";
		i2c0 = "/fragment@7:target:0";
		i2c1 = "/fragment@8:target:0";
		i2c2 = "/fragment@9:target:0";
		i2c3 = "/fragment@10:target:0";
		i2c4 = "/fragment@11:target:0";
		ion = "/fragment@6:target:0", "/fragment@25:target:0";
		mm_clk = "/fragment@7/__overlay__/sensor-main@20:clocks:0", "/fragment@8/__overlay__/sensor-sub@5a:clocks:0", "/fragment@8/__overlay__/sensor-main2@20:clocks:0";
		mm_gate = "/fragment@7/__overlay__/sensor-main@20:clocks:8", "/fragment@8/__overlay__/sensor-sub@5a:clocks:8", "/fragment@8/__overlay__/sensor-main2@20:clocks:8";
		panel = "/fragment@14:target:0";
		pin_controller = "/fragment@3:target:0";
		pll2 = "/fragment@4/__overlay__:clocks:16", "/fragment@7/__overlay__/sensor-main@20:clocks:16", "/fragment@7/__overlay__/sensor-main@20:clocks:24", "/fragment@7/__overlay__/sensor-main@20:clocks:32", "/fragment@8/__overlay__/sensor-sub@5a:clocks:16", "/fragment@8/__overlay__/sensor-sub@5a:clocks:24", "/fragment@8/__overlay__/sensor-sub@5a:clocks:32", "/fragment@8/__overlay__/sensor-main2@20:clocks:16", "/fragment@8/__overlay__/sensor-main2@20:clocks:24", "/fragment@8/__overlay__/sensor-main2@20:clocks:32";
		pmic_adc = "/fragment/__overlay__/thermal-sensor:io-channels:0", "/fragment/__overlay__/thermal-sensor@4:io-channels:0";
		pmic_eic = "/fragment/__overlay__/gpio-keys/key-volumeup:gpios:0", "/fragment/__overlay__/gpio-keys/key-power:gpios:0";
		pmic_fgu = "/fragment@17:target:0";
		pmic_typec = "/fragment/__overlay__/charger-manager/regulator@0/cable@0:extcon:0", "/fragment@18/__overlay__:extcon:4";
		pwms = "/fragment/__overlay__/backlight:pwms:0";
		reserved_memory = "/fragment@1:target:0";
		sdio0 = "/fragment@2:target:0";
		sdio1 = "/fragment/__overlay__/sprd-marlin3:sdhci-name:0";
		sound_vbc_v4_sprd_codec = "/fragment@24:target:0";
		spi0 = "/fragment@4:target:0";
		spi2 = "/fragment@13:target:0";
		sprd_headset = "/fragment@23:target:0";
		thm_zone = "/fragment@5:target:0";
		uid_end = "/fragment/__overlay__/sprd_uid:nvmem-cells:4";
		uid_start = "/fragment/__overlay__/sprd_uid:nvmem-cells:0";
		usb = "/fragment@18:target:0";
		vddcama0 = "/fragment@8/__overlay__/sensor-main2@20:vddcama-supply:0";
		vddcama1 = "/fragment@8/__overlay__/sensor-sub@5a:vddcama-supply:0";
		vddcamd0 = "/fragment@7/__overlay__/sensor-main@20:vddcamd-supply:0";
		vddcamd1 = "/fragment@8/__overlay__/sensor-sub@5a:vddcamd-supply:0";
		vddcamio = "/fragment@7/__overlay__/sensor-main@20:vddio-supply:0", "/fragment@8/__overlay__/sensor-sub@5a:vddio-supply:0", "/fragment@8/__overlay__/sensor-main2@20:vddio-supply:0";
		vddcammot = "/fragment@7/__overlay__/sensor-main@20:vddcammot-supply:0";
		vddldo0 = "/fragment@19:target:0";
		vddsim2 = "/fragment/__overlay__/sprd-marlin3:dcxo18-supply:0";
		vddwcn = "/fragment/__overlay__/sprd-marlin3:avdd12-supply:0";
		vddwifipa = "/fragment/__overlay__/sprd-marlin3:avdd33-supply:0";
	};

	__local_fixups__ {

		fragment {

			__overlay__ {

				charger-manager {
					monitored-battery = <0x0>;
				};

				lcds {

					lcd_dummy_mipi_hd {

						display-timings {
							native-mode = <0x0>;
						};
					};

					lcd_ft8756_mipi_fhd_hlt {

						display-timings {
							native-mode = <0x0>;
						};
					};

					lcd_td4310_truly_mipi_fhd {

						display-timings {
							native-mode = <0x0>;
						};
					};
				};
			};
		};

		fragment@12 {

			__overlay__ {

				charger@6b {
					monitored-battery = <0x0>;
				};
			};
		};

		fragment@14 {

			__overlay__ {
				sprd,backlight = <0x0>;
			};
		};

		fragment@15 {

			__overlay__ {
				sprd,backlight = <0x0>;
			};
		};

		fragment@17 {

			__overlay__ {
				monitored-battery = <0x0>;
			};
		};

		fragment@18 {

			__overlay__ {
				vbus-supply = <0x0>;
			};
		};

		fragment@25 {

			__overlay__ {

				heap@3 {
					memory-region = <0x0>;
				};
			};
		};

		fragment@26 {

			__overlay__ {
				sprd,logo-memory = <0x0>;
				sprd,wb-memory = <0x0>;
			};
		};

		fragment@3 {

			__overlay__ {
				pinctrl-0 = <0x0>;
				pinctrl-1 = <0x0>;
				pinctrl-10 = <0x0>;
				pinctrl-2 = <0x0>;
				pinctrl-3 = <0x0>;
				pinctrl-4 = <0x0>;
				pinctrl-5 = <0x0>;
				pinctrl-6 = <0x0>;
				pinctrl-7 = <0x0>;
				pinctrl-8 = <0x0>;
				pinctrl-9 = <0x0>;
			};
		};

		fragment@5 {

			__overlay__ {

				board-thmzone {
					thermal-sensors = <0x0>;
				};

				chg-thmzone {
					thermal-sensors = <0x0>;
				};
			};
		};

		fragment@6 {

			__overlay__ {

				heap@1 {
					memory-region = <0x0>;
				};

				heap@4 {
					memory-region = <0x0>;
				};

				heap@5 {
					memory-region = <0x0>;
				};
			};
		};
	};

	__symbols__ {
		bat = "/fragment/__overlay__/battery";
		bd_thmzone = "/fragment@5/__overlay__/board-thmzone";
		bq2560x_chg = "/fragment@12/__overlay__/charger@6b";
		chg_thermistor = "/fragment/__overlay__/thermal-sensor@4";
		chg_thmzone = "/fragment@5/__overlay__/chg-thmzone";
		drm_reserved = "/fragment@1/__overlay__/drm-mem@e32ae000";
		dummy_timing0 = "/fragment/__overlay__/lcds/lcd_dummy_mipi_hd/display-timings/timing0";
		fan53555_dcdc = "/fragment@12/__overlay__/regulator@60";
		fb_reserved = "/fragment@1/__overlay__/framebuffer-mem@fd708000";
		fd_reserved = "/fragment@1/__overlay__/faceid-mem@efaae000";
		ft8756_hlt_timing0 = "/fragment/__overlay__/lcds/lcd_ft8756_mipi_fhd_hlt/display-timings/timing0";
		gnss_reserved = "/fragment@1/__overlay__/gnss-mem@f4300000";
		gpio_121 = "/fragment@3/__overlay__/keyout0";
		gpio_122 = "/fragment@3/__overlay__/keyout1";
		gpio_123 = "/fragment@3/__overlay__/keyout2";
		gpio_124 = "/fragment@3/__overlay__/keyin0";
		gpio_125 = "/fragment@3/__overlay__/keyin1";
		gpio_126 = "/fragment@3/__overlay__/keyin2";
		gpio_144 = "/fragment@3/__overlay__/extint0";
		gpio_145 = "/fragment@3/__overlay__/extint1";
		gpio_146 = "/fragment@3/__overlay__/sda3";
		gpio_147 = "/fragment@3/__overlay__/scl3";
		gpio_16 = "/fragment@3/__overlay__/rffe1_sda";
		lcd_dummy_mipi_hd = "/fragment/__overlay__/lcds/lcd_dummy_mipi_hd";
		lcd_ft8756_mipi_fhd_hlt = "/fragment/__overlay__/lcds/lcd_ft8756_mipi_fhd_hlt";
		lcd_td4310_truly_mipi_fhd = "/fragment/__overlay__/lcds/lcd_td4310_truly_mipi_fhd";
		logo_reserved = "/fragment@1/__overlay__/logobuffer@9e000000";
		pwm_backlight = "/fragment/__overlay__/backlight";
		sensor_main = "/fragment@7/__overlay__/sensor-main@20";
		sensor_main2 = "/fragment@8/__overlay__/sensor-main2@20";
		sensor_sub = "/fragment@8/__overlay__/sensor-sub@5a";
		sprd_marlin3 = "/fragment/__overlay__/sprd-marlin3";
		tboard_thermistor = "/fragment/__overlay__/thermal-sensor";
		td4310_truly_timing0 = "/fragment/__overlay__/lcds/lcd_td4310_truly_mipi_fhd/display-timings/timing0";
		vddvbus = "/fragment@12/__overlay__/charger@6b/otg-vbus";
		vdsp_reserved = "/fragment@1/__overlay__/vdsp-mem@f09ae000";
		wb_reserved = "/fragment@1/__overlay__/writeback-mem@ff562000";
		wcn_reserved = "/fragment@1/__overlay__/wcn-mem@f4100000";
	};

	fragment {
		target-path = [2f 00];

		__overlay__ {

			backlight {
				brightness-levels = <0x0 0x3 0x4 0x5 0x6 0x7 0x8 0x9 0xa 0xb 0xc 0xd 0xe 0xf 0x10 0x11 0x12 0x13 0x14 0x15 0x16 0x17 0x18 0x19 0x1a 0x1b 0x1c 0x1d 0x1f 0x21 0x23 0x25 0x27 0x29 0x2b 0x2d 0x2e 0x30 0x32 0x34 0x36 0x38 0x3a 0x3c 0x3e 0x40 0x42 0x44 0x46 0x48 0x4a 0x4c 0x4e 0x50 0x52 0x54 0x56 0x58 0x5a 0x5c 0x5e 0x60 0x62 0x64 0x66 0x68 0x6a 0x6c 0x6e 0x70 0x72 0x74 0x76 0x78 0x7a 0x7c 0x7e 0x80 0x82 0x84 0x86 0x88 0x8a 0x8c 0x8e 0x90 0x92 0x94 0x96 0x98 0x9a 0x9c 0x9e 0xa0 0xa2 0xa4 0xa6 0xa9 0xac 0xaf 0xb2 0xb5 0xb8 0xbb 0xbe 0xc1 0xc4 0xc7 0xca 0xcd 0xd0 0xd3 0xd6 0xd9 0xdc 0xdf 0xe2 0xe5 0xe8 0xeb 0xee 0xf1 0xf4 0xf7 0xfa 0xfd 0x100 0x103 0x106 0x109 0x10c 0x10f 0x112 0x115 0x118 0x11b 0x11e 0x122 0x126 0x12a 0x12e 0x132 0x136 0x13a 0x13e 0x142 0x146 0x14a 0x14e 0x152 0x156 0x15a 0x15e 0x162 0x166 0x16a 0x16e 0x172 0x176 0x17a 0x17e 0x182 0x186 0x18a 0x18e 0x192 0x196 0x19a 0x19e 0x1a2 0x1a6 0x1aa 0x1ae 0x1b2 0x1b6 0x1ba 0x1be 0x1c3 0x1c8 0x1cd 0x1d2 0x1d7 0x1dc 0x1e1 0x1e6 0x1eb 0x1f0 0x1f5 0x1fa 0x1ff 0x204 0x209 0x20e 0x213 0x218 0x21f 0x227 0x22f 0x237 0x23f 0x247 0x24f 0x257 0x25f 0x267 0x26f 0x277 0x27f 0x287 0x28f 0x297 0x29f 0x2a7 0x2af 0x2b7 0x2bf 0x2c7 0x2cf 0x2d7 0x2df 0x2e7 0x2ef 0x2f7 0x2ff 0x307 0x30f 0x317 0x31f 0x327 0x32f 0x337 0x33f 0x347 0x34f 0x357 0x35f 0x367 0x36f 0x377 0x37f 0x387 0x38f 0x397 0x39f 0x3a7 0x3af 0x3b7 0x3bf 0x3c7 0x3cf 0x3d7 0x3df 0x3e7 0x3ef 0x3f7 0x3ff>;
				compatible = "sprd,sharkl5pro-backlight";
				default-brightness-level = <0xfa>;
				phandle = <0x15>;
				pwm-names = "backlight";
				pwms = <0xffffffff 0x2 0x9c40>;
				sprd,brightness-scale = <0x3ff>;
				sprd,max-brightness-level = <0x3ff>;
			};

			battery {
				capacity-temp-table = <0x19 0x64 0xa 0x62 0x0 0x62 0xfffffff6 0x56>;
				charge-cdp-current-microamp = <0xf4240 0xf4240>;
				charge-dcp-current-microamp = <0x249f00 0x2191c0>;
				charge-full-design-microamp-hours = <0x4532d8>;
				charge-sdp-current-microamp = <0xa1220 0xa1220>;
				charge-term-current-microamp = <0x30d40>;
				charge-unknown-current-microamp = <0xafc80 0xafc80>;
				compatible = "simple-battery";
				constant_charge_voltage_max_microvolt = <0x432380>;
				factory-internal-resistance-micro-ohms = <0x1adb0>;
				ocv-capacity-celsius = <0x14>;
				ocv-capacity-table-0 = <0x42a298 0x64 0x41c008 0x5f 0x40e160 0x5a 0x400a88 0x55 0x3f3798 0x50 0x3e6c78 0x4b 0x3dc480 0x46 0x3ce1f0 0x41 0x3c5168 0x3c 0x3b6ed8 0x37 0x3ae620 0x32 0x3a8478 0x2d 0x3a3270 0x28 0x39f008 0x23 0x39ada0 0x1e 0x395f80 0x19 0x391160 0x14 0x38b788 0xf 0x384640 0xa 0x3807c0 0x5 0x33e140 0x0>;
				phandle = <0x4>;
				resistance-temp-table = <0x19 0xa8 0xa 0x10b 0x0 0x395 0xfffffff6 0x4fc>;
				voltage-min-design-microvolt = <0x34a490>;
				voltage-temp-table = <0x10b72a 0x320 0xf0bff 0x352 0xd67de 0x384 0xbd3c8 0x3b6 0xa5a3c 0x3e8 0x901a0 0x41a 0x7cb34 0x44c 0x6b75c 0x47e 0x5c5a7 0x4b0 0x4f3d1 0x4e2 0x43e3f 0x514 0x3a2b3 0x546 0x31dea 0x578 0x2ac68 0x5aa 0x24bbb 0x5dc 0x1f982 0x60e 0x1b389 0x640 0x178e4 0x672 0x146fe 0x6a4>;
			};

			charger-manager {
				cm-battery-stat = <0x2>;
				cm-board-thermal-zone = "board-thmzone";
				cm-cap-remap-table = <0x1 0x2 0x3 0x2 0x3 0x2 0x62 0x63 0x2 0x63 0x64 0x3>;
				cm-capacity-track;
				cm-cdp-jeita-temp-table = <0x3e8 0x406 0x0 0x432380 0x44c 0x46a 0xaae60 0x432380 0x5aa 0x58c 0x118c30 0x432380 0x60e 0x5f0 0xaae60 0x3e8fa0>;
				cm-charge-voltage-drop = <0xaae60>;
				cm-charge-voltage-max = <0x632ea0>;
				cm-chargers = "bq2560x_charger";
				cm-charging-max = <0x2932e00>;
				cm-chg-thermal-zone = "chg-thmzone";
				cm-dcp-jeita-temp-table = <0x3e8 0x406 0x0 0x432380 0x44c 0x46a 0xc3500 0x432380 0x5aa 0x58c 0x1e8480 0x432380 0x60e 0x5f0 0x1e8480 0x3e8fa0>;
				cm-discharging-max = <0xa4cb80>;
				cm-fuel-gauge = "sc27xx-fgu";
				cm-fullbatt-capacity = <0x64>;
				cm-fullbatt-current = <0x2e630>;
				cm-fullbatt-vchkdrop-ms = <0x7530>;
				cm-fullbatt-vchkdrop-volt = <0xea60>;
				cm-fullbatt-voltage = <0x426030>;
				cm-name = "battery";
				cm-num-chargers = <0x1>;
				cm-one-cap-time = <0x1e>;
				cm-poll-interval = <0x2710>;
				cm-poll-mode = <0x2>;
				cm-sdp-jeita-temp-table = <0x3e8 0x406 0x0 0x432380 0x44c 0x46a 0x7a120 0x432380 0x5aa 0x58c 0x7a120 0x432380 0x60e 0x5f0 0x7a120 0x3e8fa0>;
				cm-shutdown-voltage = <0x2f4d60>;
				cm-tickle-time-out = <0x5dc>;
				cm-unknown-jeita-temp-table = <0x3e8 0x406 0x0 0x432380 0x44c 0x46a 0x7a120 0x432380 0x5aa 0x58c 0x7a120 0x432380 0x60e 0x5f0 0x7a120 0x3e8fa0>;
				cm-wdt-interval = <0x3c>;
				compatible = "charger-manager";
				monitored-battery = <0x4>;
				status = "okay";

				regulator@0 {
					cm-regulator-name = "vddgen0";

					cable@0 {
						cm-cable-name = "USB";
						extcon = <0xffffffff>;
					};
				};
			};

			fingerprint@0 {
				compatible = "sil,silead_fp";
				irq-gpios = <0xffffffff 0xd 0x0>;
				rst-gpios = <0xffffffff 0x83 0x0>;
			};

			flash-gpio {
				compatible = "sprd,flash-aw3641";
				flash-en-gpios = <0xffffffff 0x88 0x0>;
				flash-ic = <0xe39>;
				flash-torch-en-gpios = <0xffffffff 0x89 0x0>;
			};

			gpio-keys {
				compatible = "gpio-keys";

				key-power {
					debounce-interval = <0x2>;
					gpios = <0xffffffff 0x1 0x1>;
					label = "Power Key";
					linux,code = <0x74>;
					wakeup-source;
				};

				key-volumedown {
					debounce-interval = <0x2>;
					gpios = <0xffffffff 0x7c 0x1>;
					label = "Volume Down Key";
					linux,code = <0x72>;
					wakeup-source;
				};

				key-volumeup {
					debounce-interval = <0x2>;
					gpios = <0xffffffff 0x4 0x0>;
					label = "Volume Up Key";
					linux,code = <0x73>;
					wakeup-source;
				};
			};

			lcds {

				lcd_dummy_mipi_hd {
					phandle = <0x1c>;
					sprd,dsi-color-format = "rgb888";
					sprd,dsi-lane-number = <0x4>;
					sprd,dsi-work-mode = <0x1>;
					sprd,initial-command = [13 78 00 01 11 13 64 00 01 29];
					sprd,sleep-in-command = [13 0a 00 01 28 13 78 00 01 10];
					sprd,sleep-out-command = [13 78 00 01 11 13 64 00 01 29];

					display-timings {
						native-mode = <0x3>;

						timing0 {
							clock-frequency = <0x493e000>;
							hactive = <0x2d0>;
							hback-porch = <0x3c>;
							hfront-porch = <0x50>;
							hsync-len = <0x3c>;
							phandle = <0x3>;
							vactive = <0x500>;
							vback-porch = <0xc>;
							vfront-porch = <0x26>;
							vsync-len = <0x4>;
						};
					};
				};

				lcd_ft8756_mipi_fhd_hlt {
					phandle = <0x1a>;
					sprd,dsi-color-format = "rgb888";
					sprd,dsi-lane-number = <0x4>;
					sprd,dsi-work-mode = <0x1>;
					sprd,esd-check-enable = <0x1>;
					sprd,esd-check-mode = <0x0>;
					sprd,esd-check-register = <0xa>;
					sprd,esd-check-value = <0x9c>;
					sprd,height-mm = <0x93>;
					sprd,initial-command = <0x23000002 0x2900 0x4ff87 0x56012300 0x20080 0x29000003 0xff875623 0x200 0xa1290000 0x7b30438 0x96000fc 0x23000002 0x802900 0x7c000 0x86002400 0x46230000 0x2009029 0x7c0 0x860024 0x462300 0x200a0 0x29000007 0xc0010700 0x24004623 0x200 0xb0290000 0x6c00086 0x244623 0x200 0xc1290000 0x9c000c4 0x990083 0xe52300 0x200d7 0x29000007 0xc0008300 0x24004623 0x200 0xa3290000 0x7c10034 0x340002 0x23000002 0x802900 0x11ce01 0x81091300 0xec00ec00 0x8500a000 0x74007423 0x200 0x90290000 0x10ce008e 0xeb6008e 0x80091300 0x4003a39 0x2b230000 0x200a029 0x4ce 0x20000023 0x200 0xb0290000 0x4ce2200 0x230000 0x200d129 0x8ce 0x100 0x23 0x200 0xe1290000 0xcce0802 0x4d024d02 0x4d000000 0x230000 0x200f129 0xace 0x160b0f01 0x43014301 0x3d230000 0x200b029 0x5cf 0xdade 0x23000002 0xb52900 0x5cf05 0x5121623 0x200 0xc0290000 0x5cf0909 0x4c502300 0x200c5 0x29000005 0xcf000008 0xc230000 0x200e823 0x2c0 0x40230000 0x200ca23 0x2c0 0x80230000 0x2008029 0x9c2 0x83010181 0x82010181 0x23000002 0xa02900 0x10c28a 0xa000086 0x890a0000 0x86880a00 0x862300 0x200b0 0x29000006 0xc2870a00 0x862300 0x200e0 0x2900000f 0xc2333333 0x33333300 0x30910 0x6a018123 0x200 0x80290000 0x11cbfdfd 0x3c30fd0c 0x1cfd02fe 0xfdfdfdfd 0xfc2300 0x20090 0x29000011 0xcbff0000 0xff0000 0xff00 0x0 0x230000 0x200a029 0x5cb 0x0 0x23000002 0xb02900 0x5cb50 0x41a45023 0x200 0xc0290000 0x5cb5041 0xa4502300 0x20080 0x29000011 0xcc252500 0x2429291b 0x181a1719 0x16000000 0x230000 0x2009029 0x9cc 0x7090126 0x26222403 0x23000002 0x802900 0x11cd25 0x25002429 0x291b181a 0x17191600 0x23 0x200 0x90290000 0x9cd0608 0x1262622 0x24022300 0x200a0 0x29000011 0xcc252500 0x2400001b 0x181a1719 0x16000000 0x230000 0x200b029 0x9cc 0x8060126 0x26242302 0x23000002 0xa02900 0x11cd25 0x25002400 0x1b181a 0x17191600 0x23 0x200 0xb0290000 0x9cd0907 0x1262624 0x23032300 0x200a0 0x29000004 0xc48dd88d 0x23000002 0x932300 0x2c5da 0x23000002 0xa42300 0x2d700 0x23000002 0x9b2300 0x2f54b 0x23000002 0x932900 0x3f500 0x230000 0x2009d29 0x2f5 0x49230000 0x2008229 0x3f5 0x2300 0x20080 0x29000003 0xf5595923 0x200 0x84290000 0x4f55959 0x59230000 0x2009623 0x2f5 0x59230000 0x200a623 0x2f5 0x59230000 0x200ca23 0x2c0 0x80230000 0x200b123 0x2f5 0x1f230000 0x2000029 0x3d8 0x29292300 0x20000 0x29000029 0xe1000608 0xf2f1920 0x26306938 0x3e444920 0x4d555c63 0x996a7178 0x811c8a90 0x969ddba6 0xb1bfc89a 0xd5e7f5ff 0x7230000 0x2000029 0x29e2 0x6080f 0x2f1b2228 0x32693a40 0x464b204f 0x575e6599 0x6c717881 0x1c8a9096 0x9ddba6b1 0xbfc89ad5 0xe7f5ff07 0x23000002 0x2900 0x29e300 0x6080f2f 0x19202630 0x69383e44 0x49204d55 0x5c63996a 0x7178811c 0x8a90969d 0xdba6b1bf 0xc89ad5e7 0xf5ff0723 0x200 0x290000 0x29e40006 0x80f2f1b 0x22283269 0x3a40464b 0x204f575e 0x65996c71 0x78811c8a 0x90969ddb 0xa6b1bfc8 0x9ad5e7f5 0xff072300 0x20000 0x29000029 0xe5000608 0xf2f1920 0x26306938 0x3e444920 0x4d555c63 0x996a7178 0x811c8a90 0x969ddba6 0xb1bfc89a 0xd5e7f5ff 0x7290000 0x29e60006 0x80f2f1b 0x22283269 0x3a40464b 0x204f575e 0x65996c71 0x78811c8a 0x90969ddb 0xa6b1bfc8 0x9ad5e7f5 0xff072300 0x200b6 0x29000005 0xc52d2d19 0x19230000 0x2008523 0x2c4 0x1c230000 0x2008023 0x2a4 0x6c230000 0x2008d23 0x2a5 0x6230000 0x200c623 0x2f5 0x2230000 0x200a923 0x2f5 0xc1230000 0x200b123 0x2c5 0x8a230000 0x200b423 0x2c5 0x8a230000 0x200a029 0x11c3 0x15012345 0x54321000 0x3450 0x12210543 0x23000002 0x8c2900 0x4c300 0x2300 0x20089 0x29000004 0xc0020c07 0x23000002 0xcb2300 0x2c019 0x23000002 0x842900 0x3c526 0x26230000 0x2008023 0x2a4 0x6c230000 0x2009723 0x2c4 0x1230000 0x200d029 0xdc3 0x46000000 0x46000000 0x46000000 0x23780002 0x11002314 0x22900>;
					sprd,phy-bit-clock = <0x151670>;
					sprd,phy-escape-clock = <0x4e20>;
					sprd,reset-off-sequence = <0x0 0xa>;
					sprd,reset-on-sequence = <0x1 0xa 0x0 0xa 0x1 0x14>;
					sprd,sleep-in-command = [13 0a 00 01 28 13 78 00 01 10];
					sprd,sleep-out-command = [13 78 00 01 11 13 32 00 01 29];
					sprd,width-mm = <0x54>;

					display-timings {
						native-mode = <0x1>;

						timing0 {
							clock-frequency = <0xb71b000>;
							hactive = <0x438>;
							hback-porch = <0x5e>;
							hfront-porch = <0x56>;
							hsync-len = <0x10>;
							phandle = <0x1>;
							vactive = <0x960>;
							vback-porch = <0x3c>;
							vfront-porch = <0x24>;
							vsync-len = <0xa>;
						};
					};
				};

				lcd_td4310_truly_mipi_fhd {
					phandle = <0x1b>;
					sprd,dsi-color-format = "rgb888";
					sprd,dsi-lane-number = <0x4>;
					sprd,dsi-work-mode = <0x1>;
					sprd,esd-check-enable = <0x1>;
					sprd,esd-check-mode = <0x0>;
					sprd,esd-check-register = <0xa>;
					sprd,esd-check-value = <0x1c>;
					sprd,height-mm = <0x88>;
					sprd,initial-command = [39 00 00 02 b0 00 39 00 00 04 b3 31 00 06 39 00 00 02 b4 00 39 00 00 06 b6 33 5b 81 72 00 39 00 00 08 b8 57 3d 19 1e 0a 50 50 39 00 00 08 b9 6f 3d 28 3c 14 c8 c8 39 00 00 08 ba b5 33 41 64 23 a0 a0 39 00 00 03 bb 14 14 39 00 00 03 bc 37 32 39 00 00 03 bd 64 32 39 00 00 02 be 04 39 00 00 02 c0 00 39 00 00 31 c1 04 40 00 00 26 15 19 0b 63 d2 d9 9a 73 ef bd e7 5c 6b 93 4d 22 18 8b 2a 41 00 00 00 00 00 00 00 00 00 40 02 22 1b 06 03 00 0f ff 00 01 00 00 00 39 00 00 19 c2 01 f8 70 08 68 08 0c 10 00 08 30 00 00 00 00 00 00 00 00 08 00 00 00 00 39 00 00 3f c3 86 d8 6d 86 d0 00 00 00 00 00 44 24 42 00 00 48 84 88 00 00 01 01 03 28 00 01 00 01 00 00 19 00 19 00 00 00 19 00 19 00 00 00 00 00 00 00 00 00 32 00 32 00 5a 02 00 00 00 00 00 00 40 00 39 00 00 15 c4 70 00 00 00 11 11 00 00 00 02 02 31 01 00 00 00 02 01 01 01 39 00 00 09 c5 08 00 00 00 00 70 00 00 39 00 00 40 c6 42 21 21 05 3d 05 3d 01 02 01 02 05 05 00 00 05 05 0b 0c 05 42 00 6e 61 00 00 00 00 00 00 00 00 00 00 00 00 00 00 00 00 00 00 00 00 00 00 00 00 00 00 00 00 00 00 00 00 00 00 00 00 00 00 00 39 00 00 27 c7 00 1f 30 43 52 5c 72 80 8b 95 45 4f 5c 70 79 85 90 93 bf 00 1f 30 43 52 5c 72 80 8b 95 45 4f 5c 70 79 85 90 93 bf 39 00 00 38 c8 00 00 00 00 00 fc 00 00 00 00 00 fc 00 00 00 00 00 fc 00 00 00 00 00 fc 00 00 00 00 00 fc 00 00 00 00 00 fc 00 00 00 00 00 fc 00 00 00 00 00 fc 00 00 00 00 00 fc 00 39 00 00 14 c9 00 00 00 00 00 fc 00 00 00 00 00 fc 00 00 00 00 00 fc 00 39 00 00 2c ca 1c fc fc fc 00 00 00 00 00 00 00 00 00 00 00 00 00 00 00 00 00 00 00 00 00 00 00 00 00 00 00 00 00 00 00 00 00 00 00 00 00 00 00 39 00 00 1c cb ff ff ff ff 0f 00 08 00 01 00 31 f0 40 08 00 00 00 00 00 00 00 00 00 00 00 00 00 39 00 00 03 cc 02 01 39 00 00 27 cd 25 00 28 00 28 00 5c 02 df df e0 e0 d6 d6 e0 e0 01 00 00 00 32 00 32 00 5d 02 24 24 01 33 00 33 00 5e 02 24 24 a2 39 00 00 1a ce 5d 40 49 53 59 5e 63 68 6e 74 7e 8a 98 a8 bb d0 ff 04 00 04 04 42 00 69 5a 39 00 00 03 cf 4a 1d 39 00 00 14 d0 33 57 d4 31 01 10 10 10 19 19 00 00 00 00 00 00 00 6d 65 39 00 00 02 d1 00 39 00 00 16 d3 1b 3b bb 77 77 77 bb b3 33 00 00 6d 6e c7 c7 33 bb f2 fd c6 0b 39 00 00 0b d5 03 00 00 02 0e 02 0e 01 00 00 39 00 00 02 d6 01 39 00 00 22 d7 f6 ff 03 05 41 24 80 1f c7 1f 1b 00 0c 07 20 00 00 00 00 00 0c 00 1f 00 fc 00 00 ab 67 7e 5d 26 00 39 00 00 08 d9 00 16 14 3f 0f 57 04 39 00 00 05 dd 30 06 23 65 39 00 00 05 de 00 3f ff 90 39 00 00 02 ea 1f 39 00 00 04 ee 41 51 00 39 00 00 04 f1 00 00 00 15 00 00 02 35 00 05 14 00 01 29 05 64 00 01 11];
					sprd,phy-bit-clock = <0x10c8e0>;
					sprd,phy-escape-clock = <0x4e20>;
					sprd,reset-off-sequence = <0x0 0x5>;
					sprd,reset-on-sequence = <0x1 0x5 0x0 0x5 0x1 0x14>;
					sprd,sleep-in-command = [13 0a 00 01 28 13 78 00 01 10];
					sprd,sleep-out-command = [13 78 00 01 11 13 32 00 01 29];
					sprd,use-dcs-write;
					sprd,width-mm = <0x44>;

					display-timings {
						native-mode = <0x2>;

						timing0 {
							clock-frequency = <0x927c000>;
							hactive = <0x438>;
							hback-porch = <0x14>;
							hfront-porch = <0x41>;
							hsync-len = <0x2>;
							phandle = <0x2>;
							vactive = <0x870>;
							vback-porch = <0x1c>;
							vfront-porch = <0x2>;
							vsync-len = <0x4>;
						};
					};
				};
			};

			sprd-marlin3 {
				adma-rx;
				adma-tx;
				avdd12-bound-wbreq = <0x1ac8 0x1000 0x0 0x1000>;
				avdd12-parent-bound-chip = <0x1a4c 0x1 0x0 0x1>;
				avdd12-supply = <0xffffffff>;
				avdd33-bound-wbreq = <0x1acc 0x4 0x0 0x4>;
				avdd33-supply = <0xffffffff>;
				clock-names = "clk_32k", "source", "enable";
				clocks = <0xffffffff 0x2 0xffffffff 0xffffffff 0x3>;
				compatible = "sprd,marlin3";
				dcxo18-supply = <0xffffffff>;
				enable-gpios = <0xffffffff 0x74 0x1>;
				m2-to-ap-coexist-gpios = <0xffffffff 0x77 0x1>;
				m2-to-ap-irq-gpios = <0xffffffff 0x5e 0x1>;
				m2-wakeup-ap-gpios = <0xffffffff 0x20 0x1>;
				permit-ap-send-gpios = <0xffffffff 0x79 0x1>;
				phandle = <0x1d>;
				reg = <0x0 0xf4100000 0x0 0x200000 0x0 0xf4300000 0x0 0x100000>;
				reg-names = "btwf_mem", "gnss_mem";
				reset-gpios = <0xffffffff 0x5f 0x1>;
				sdhci-name = <0xffffffff>;
				sprd,btwf-file-name = "/dev/block/platform/soc/soc:ap-apb/71400000.sdio/by-name/wcnmodem";
				sprd,gnss-file-name = "/dev/block/platform/soc/soc:ap-apb/71400000.sdio/by-name/gnssmodem";
			};

			sprd-wlan {
				compatible = "sprd,sc2355-wifi";
			};

			sprd_uid {
				compatible = "sprd-uid";
				nvmem-cell-names = "uid_start", "uid_end";
				nvmem-cells = <0xffffffff 0xffffffff>;
			};

			thermal-sensor {
				#thermal-sensor-cells = <0x0>;
				compatible = "generic-adc-thermal";
				io-channel-names = "sensor-channel";
				io-channels = <0xffffffff 0x1>;
				phandle = <0x10>;
				temperature-lookup-table = <0xffff64c2 0x46b 0xffff8baf 0x456 0xffffb3e8 0x432 0xffffedb9 0x3d7 0x277e 0x346 0x60e5 0x28e 0xaf7a 0x19d 0xd677 0x13c 0xfd7f 0xee 0x12484 0xb2 0x14b93 0x85 0x172a3 0x64 0x199b0 0x4b 0x1c0c9 0x39 0x1e7c8 0x2b>;
			};

			thermal-sensor@4 {
				#thermal-sensor-cells = <0x0>;
				compatible = "generic-adc-thermal";
				io-channel-names = "sensor-channel";
				io-channels = <0xffffffff 0x4>;
				phandle = <0x11>;
				temperature-lookup-table = <0xffff64c2 0x46b 0xffff8baf 0x456 0xffffb3e8 0x432 0xffffedb9 0x3d7 0x277e 0x346 0x60e5 0x28e 0xaf7a 0x19d 0xd677 0x13c 0xfd7f 0xee 0x12484 0xb2 0x14b93 0x85 0x172a3 0x64 0x199b0 0x4b 0x1c0c9 0x39 0x1e7c8 0x2b>;
			};
		};
	};

	fragment@0 {
		target = <0xffffffff>;

		__overlay__ {
			bootargs_ext = "androidboot.hardware=v880 androidboot.dtbo_idx=0";
		};
	};

	fragment@1 {
		target = <0xffffffff>;

		__overlay__ {

			drm-mem@e32ae000 {
				phandle = <0x12>;
				reg = <0x0 0xe32ae000 0x0 0xc800000>;
			};

			faceid-mem@efaae000 {
				phandle = <0x13>;
				reg = <0x0 0xefaae000 0x0 0x500000>;
			};

			framebuffer-mem@fd708000 {
				phandle = <0x17>;
				reg = <0x0 0xfd708000 0x0 0x1e5a000>;
			};

			gnss-mem@f4300000 {
				phandle = <0x1f>;
				reg = <0x0 0xf4300000 0x0 0x100000>;
			};

			logobuffer@9e000000 {
				phandle = <0x19>;
				reg = <0x0 0x9e000000 0x0 0x9e4000>;
			};

			vdsp-mem@f09ae000 {
				phandle = <0x14>;
				reg = <0x0 0xf09ae000 0x0 0x3700000>;
			};

			wcn-mem@f4100000 {
				phandle = <0x1e>;
				reg = <0x0 0xf4100000 0x0 0x200000>;
			};

			writeback-mem@ff562000 {
				phandle = <0x18>;
				reg = <0x0 0xff562000 0x0 0xa1e000>;
			};
		};
	};

	fragment@10 {
		target = <0xffffffff>;

		__overlay__ {
			status = "okay";
		};
	};

	fragment@11 {
		target = <0xffffffff>;

		__overlay__ {
			clock-frequency = <0x186a0>;
			status = "okay";

			ocp_wpad@3e {
				compatible = "ocp,ocp_wpad";
				ocp,n-gpio = <0xffffffff 0x85 0x0>;
				ocp,p-gpio = <0xffffffff 0x84 0x0>;
				reg = <0x3e>;
			};
		};
	};

	fragment@12 {
		target = <0xffffffff>;

		__overlay__ {
			status = "okay";

			charger@6b {
				compatible = "ti,bq2560x_chg";
				extcon = <0xffffffff>;
				monitored-battery = <0x4>;
				phandle = <0x25>;
				phys = <0xffffffff>;
				reg = <0x6b>;

				otg-vbus {
					phandle = <0x16>;
					regulator-name = "vddvbus";
				};
			};

			cpudvfs-dcdc-cpu1@62 {
				compatible = "sprd,cpudvfs-regulator-sharkl5pro";
				dvfs-dcdc-i2c = <0x1>;
				reg = <0x62>;
			};

			regulator@60 {
				compatible = "fcs,fan53555";
				fcs,suspend-voltage-selector = <0x1>;
				phandle = <0x26>;
				reg = <0x60>;
				regulator-always-on;
				regulator-max-microvolt = <0x12c4b0>;
				regulator-min-microvolt = <0x927c0>;
				regulator-name = "fan53555";
				regulator-ramp-delay = <0xfa00>;
			};
		};
	};

	fragment@13 {
		target = <0xffffffff>;

		__overlay__ {
			status = "okay";

			spi_touch@0 {
				compatible = "focaltech,fts";
				focaltech,display-coords = <0x0 0x0 0x438 0x960>;
				focaltech,max-touch-number = <0xa>;
				reg = <0x0>;
				spi-max-frequency = <0x5b8d80>;
				touch,irq-gpio = <0xffffffff 0x90 0x0>;
				touch,reset-gpio = <0xffffffff 0x91 0x0>;
			};
		};
	};

	fragment@14 {
		target = <0xffffffff>;

		__overlay__ {
			reset-gpio = <0xffffffff 0x32 0x0>;
			sprd,backlight = <0x15>;
		};
	};

	fragment@15 {
		target = <0xffffffff>;

		__overlay__ {
			sprd,backlight = <0x15>;
		};
	};

	fragment@16 {
		target = <0xffffffff>;

		__overlay__ {
			sprd-freq = <0x535 0x300 0x100 0x180 0x200 0xbacd 0x535>;
			sprd-scene = "boost", "lcdon", "lcdoff", "camlow", "camhigh", "camveryhigh", "faceid";
		};
	};

	fragment@17 {
		target = <0xffffffff>;

		__overlay__ {
			first-calib-capacity = <0x14>;
			first-calib-voltage = <0x345670>;
			monitored-battery = <0x4>;
			sprd,calib-resistance-real = <0x2710>;
			sprd,calib-resistance-spec = <0x4e20>;
			sprd,comp-resistance-mohm = <0x14>;
		};
	};

	fragment@18 {
		target = <0xffffffff>;

		__overlay__ {
			extcon = <0xffffffff 0xffffffff>;
			vbus-supply = <0x16>;
		};
	};

	fragment@19 {
		target = <0xffffffff>;

		__overlay__ {
			regulator-always-on;
		};
	};

	fragment@2 {
		target = <0xffffffff>;

		__overlay__ {
			cd-gpios = <0xffffffff 0x13 0x0>;
		};
	};

	fragment@20 {
		target = <0xffffffff>;

		__overlay__ {
			sprd,hw-channels = <0x2 0x18cc 0x3 0x18cc 0xd 0x1874 0xf 0x1874 0x11 0x1844 0x13 0x1854 0x15 0x1864 0x1e 0x1820 0x23 0x19b8 0x27 0x19ac>;
		};
	};

	fragment@21 {
		target = <0xffffffff>;

		__overlay__ {
			chnl-in-i2c = <0x0>;
			pmic-type-num = <0x0>;
			slew-rate = <0x249f>;
			top-dvfs-adi-state = <0x70 0x0 0xf>;
			tuning-latency-us = <0x0>;
			voltage-down-delay = <0x32 0x64 0x0 0xffff 0x600 0x64 0x64 0x10 0xffff 0xa00 0x96 0x60 0x0 0xffff 0xf00 0xc8 0x60 0x10 0xffff 0x1400 0xfa 0x5c 0x0 0xffff 0x1900 0x12c 0x5c 0x10 0xffff 0x1e00 0x15e 0x114 0x0 0xffff 0x2300>;
			voltage-grade = <0x0 0xf0 0xf4 0x0 0x1ff 0x1 0xf0 0xf4 0x9 0x1ff 0x2 0x100 0xf4 0x12 0x1ff 0x3 0x110 0xf8 0x0 0x1ff 0x4 0x120 0xf8 0x9 0x1ff 0x5 0x130 0xf8 0x12 0x1ff 0x6 0x140 0xfc 0x0 0x1ff>;
			voltage-grade-num = <0x7>;
			voltage-up-delay = <0x32 0x58 0x0 0xffff 0x600 0x64 0x58 0x10 0xffff 0xa00 0x96 0x54 0x0 0xffff 0xf00 0xc8 0x54 0x10 0xffff 0x1400 0xfa 0x50 0x0 0xffff 0x1900 0x12c 0x50 0x10 0xffff 0x1e00 0x15e 0x110 0x0 0xffff 0x2300>;
		};
	};

	fragment@22 {
		target = <0xffffffff>;

		__overlay__ {
			chnl-in-i2c = <0x0>;
			pmic-type-num = <0x0>;
			slew-rate = <0x249f>;
			supply-type-sel = <0x120 0x0 0x0>;
			top-dvfs-adi-state = <0x9c 0x0 0xf>;
			tuning-latency-us = <0xc8>;
			voltage-down-delay = <0x32 0x90 0x0 0xffff 0x600 0x64 0x90 0x10 0xffff 0xa00 0x96 0x8c 0x0 0xffff 0xf00 0xc8 0x8c 0x10 0xffff 0x1400 0xfa 0x88 0x0 0xffff 0x1900 0x12c 0x88 0x10 0xffff 0x1e00 0x15e 0x11c 0x0 0xffff 0x2300>;
			voltage-grade = <0x0 0xf0 0x100 0x0 0x1ff 0x1 0x100 0x100 0x9 0x1ff 0x2 0x110 0x100 0x12 0x1ff 0x3 0x120 0x104 0x0 0x1ff 0x4 0x130 0x104 0x9 0x1ff 0x5 0x140 0x104 0x12 0x1ff>;
			voltage-grade-num = <0x6>;
			voltage-up-delay = <0x32 0x84 0x0 0xffff 0x1600 0x64 0x84 0x10 0xffff 0xa00 0x96 0x80 0x0 0xffff 0x1f00 0xc8 0x80 0x10 0xffff 0x1400 0xfa 0x7c 0x0 0xffff 0x1900 0x12c 0x7c 0x10 0xffff 0x1e00 0x15e 0x118 0x0 0xffff 0x2300>;
		};
	};

	fragment@23 {
		target = <0xffffffff>;

		__overlay__ {
			sprd,spk-route-hp;
			status = "okay";
		};
	};

	fragment@24 {
		target = <0xffffffff>;

		__overlay__ {
			sprd,spk-ext-pa-gpio = <0xffffffff 0x86 0x0>;
			sprd,spk-ext-pa-info = <0x0 0x0 0x2 0x0>;
			status = "okay";
		};
	};

	fragment@25 {
		target = <0xffffffff>;

		__overlay__ {

			heap@3 {
				label = "carveout_fb";
				memory-region = <0x17>;
				reg = <0x3>;
				type = <0x2>;
			};
		};
	};

	fragment@26 {
		target = <0xffffffff>;

		__overlay__ {
			sprd,logo-memory = <0x19>;
			sprd,wb-memory = <0x18>;
		};
	};

	fragment@3 {
		target = <0xffffffff>;

		__overlay__ {
			pinctrl-0 = <0x5>;
			pinctrl-1 = <0x6>;
			pinctrl-10 = <0xf>;
			pinctrl-2 = <0x7>;
			pinctrl-3 = <0x8>;
			pinctrl-4 = <0x9>;
			pinctrl-5 = <0xa>;
			pinctrl-6 = <0xb>;
			pinctrl-7 = <0xc>;
			pinctrl-8 = <0xd>;
			pinctrl-9 = <0xe>;
			pinctrl-names = "gpio_121", "gpio_122", "gpio_123", "gpio_124", "gpio_125", "gpio_126", "gpio_144", "gpio_145", "gpio_146", "gpio_147", "gpio_16";

			extint0 {
				function = "func4";
				phandle = <0xb>;
				pins = "SHARKL5PRO_EXTINT0";
			};

			extint1 {
				function = "func4";
				phandle = <0xc>;
				pins = "SHARKL5PRO_EXTINT1";
			};

			keyin0 {
				function = "func4";
				phandle = <0x8>;
				pins = "SHARKL5PRO_KEYIN0";
			};

			keyin1 {
				function = "func4";
				phandle = <0x9>;
				pins = "SHARKL5PRO_KEYIN1";
			};

			keyin2 {
				function = "func4";
				phandle = <0xa>;
				pins = "SHARKL5PRO_KEYIN2";
			};

			keyout0 {
				function = "func4";
				phandle = <0x5>;
				pins = "SHARKL5PRO_KEYOUT0";
			};

			keyout1 {
				function = "func4";
				phandle = <0x6>;
				pins = "SHARKL5PRO_KEYOUT1";
			};

			keyout2 {
				function = "func4";
				phandle = <0x7>;
				pins = "SHARKL5PRO_KEYOUT2";
			};

			rffe1_sda {
				function = "func4";
				phandle = <0xf>;
				pins = "SHARKL5PRO_RFFE1_SDA";
			};

			scl3 {
				function = "func4";
				phandle = <0xe>;
				pins = "SHARKL5PRO_SCL3";
			};

			sda3 {
				function = "func4";
				phandle = <0xd>;
				pins = "SHARKL5PRO_SDA3";
			};
		};
	};

	fragment@4 {
		target = <0xffffffff>;

		__overlay__ {
			clock-names = "enable", "spi", "source";
			clocks = <0xffffffff 0x5 0xffffffff 0xa 0xffffffff 0x3>;
		};
	};

	fragment@5 {
		target = <0xffffffff>;

		__overlay__ {

			board-thmzone {
				phandle = <0x20>;
				polling-delay = <0x0>;
				polling-delay-passive = <0x0>;
				thermal-sensors = <0x10>;
			};

			chg-thmzone {
				phandle = <0x21>;
				polling-delay = <0x0>;
				polling-delay-passive = <0x0>;
				thermal-sensors = <0x11>;
			};
		};
	};

	fragment@6 {
		target = <0xffffffff>;

		__overlay__ {

			heap@1 {
				label = "carveout_mm";
				memory-region = <0x12>;
				reg = <0x1>;
				type = <0x2>;
			};

			heap@4 {
				label = "carveout_fd";
				memory-region = <0x13>;
				reg = <0x4>;
				type = <0x2>;
			};

			heap@5 {
				label = "carveout_vdsp";
				memory-region = <0x14>;
				reg = <0x5>;
				type = <0x2>;
			};
		};
	};

	fragment@7 {
		target = <0xffffffff>;

		__overlay__ {
			clock-frequency = <0x61a80>;
			status = "okay";

			sensor-main@20 {
				avdd-gpios = <0xffffffff 0x10 0x0>;
				clock-names = "clk_src", "sensor_eb", "clk_96m", "clk_76m8", "clk_48m", "clk_26m";
				clocks = <0xffffffff 0x2 0xffffffff 0xd 0xffffffff 0x4 0xffffffff 0x10 0xffffffff 0x5 0xffffffff>;
				compatible = "sprd,sensor-main";
				csi = <0xffffffff>;
				phandle = <0x22>;
				reg = <0x20>;
				reset-gpios = <0xffffffff 0x2c 0x0>;
				sprd,phyid = <0x0>;
				vddcamd-supply = <0xffffffff>;
				vddcammot-supply = <0xffffffff>;
				vddio-supply = <0xffffffff>;
			};
		};
	};

	fragment@8 {
		target = <0xffffffff>;

		__overlay__ {
			clock-frequency = <0x61a80>;
			status = "okay";

			sensor-main2@20 {
				clock-names = "clk_src", "sensor_eb", "clk_96m", "clk_76m8", "clk_48m", "clk_26m";
				clocks = <0xffffffff 0x4 0xffffffff 0xb 0xffffffff 0x4 0xffffffff 0x10 0xffffffff 0x5 0xffffffff>;
				compatible = "sprd,sensor-main2";
				csi = <0xffffffff>;
				phandle = <0x24>;
				power-down-gpios = <0xffffffff 0x70 0x0>;
				reg = <0x20>;
				reset-gpios = <0xffffffff 0x28 0x0>;
				sprd,phyid = <0x2>;
				vddcama-supply = <0xffffffff>;
				vddio-supply = <0xffffffff>;
			};

			sensor-sub@5a {
				clock-names = "clk_src", "sensor_eb", "clk_96m", "clk_76m8", "clk_48m", "clk_26m";
				clocks = <0xffffffff 0x3 0xffffffff 0xc 0xffffffff 0x4 0xffffffff 0x10 0xffffffff 0x5 0xffffffff>;
				compatible = "sprd,sensor-sub";
				csi = <0xffffffff>;
				phandle = <0x23>;
				reg = <0x5a>;
				reset-gpios = <0xffffffff 0x2d 0x0>;
				sprd,phyid = <0x3>;
				vddcama-supply = <0xffffffff>;
				vddcamd-supply = <0xffffffff>;
				vddio-supply = <0xffffffff>;
			};
		};
	};

	fragment@9 {
		target = <0xffffffff>;

		__overlay__ {
			clock-frequency = <0x61a80>;
			status = "disabled";
		};
	};
};
